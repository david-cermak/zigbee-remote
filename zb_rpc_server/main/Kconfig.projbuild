## zb_rpc_server/main/Kconfig.projbuild
```kconfig
menu "PPP UART Zigbee RPC server"

    config PPP_UART_NUM
        int "PPP UART port number"
        range 0 1
        default 0
        help
            UART peripheral used by PPP. The console (idf.py monitor) must use
            the other UART.

            With a single USB-UART cable (default) PPP runs on UART0, using the
            ESP32-H2 default UART0 pins, and the console is moved to UART1.
            For two cables, keep the console on UART0 and set this to 1 so PPP
            uses UART1 on the custom pins below.

    config PPP_UART_TX_PIN
        int "PPP UART TX pin"
        range 0 27
        default 24 if PPP_UART_NUM = 0
        default 10

    config PPP_UART_RX_PIN
        int "PPP UART RX pin"
        range 0 27
        default 23 if PPP_UART_NUM = 0
        default 11

    config PPP_UART_BAUD_RATE
        int "PPP UART baud rate"
        range 9600 3000000
        default 115200

    config PPP_MTU
        int "PPP IPv4 MTU"
        range 576 1500
        default 1500

    config PPP_TCP_SERVER_PORT
        int "TCP RPC server port"
        range 1 65535
        default 3333

    config ZB_EXAMPLE_PRIMARY_CHANNEL
        int "Primary Zigbee channel"
        range 11 26
        default 13

    config ZB_EXAMPLE_SECONDARY_CHANNEL_MASK
        hex "Secondary Zigbee channel mask"
        default 0x07FFF800

endmenu
```
